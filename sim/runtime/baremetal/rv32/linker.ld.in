/* Generated by project_config.py; do not edit.
 * Configuration digest: @CONFIG_DIGEST@
 */
OUTPUT_ARCH(riscv)
ENTRY(_start)

MEMORY
{
@MEMORY_REGIONS@
}

REGION_ALIAS("DATA", @DATA_REGION@);

SECTIONS
{
  .text :
  {
    KEEP(*(.text.start))
    *(.text .text.*)
  } > IMAGE

  .rodata :
  {
    *(.rodata .rodata.*)
    *(.srodata .srodata.*)
    *(.eh_frame .eh_frame.*)
  } > IMAGE

  .init_tables : ALIGN(4)
  {
    __copy_table_start = .;
@COPY_TABLE@
    __copy_table_end = .;

    __zero_table_start = .;
@ZERO_TABLE@
    __zero_table_end = .;
  } > IMAGE

  .data : ALIGN(4)
  {
    . = ALIGN(4);
    __data_start = .;
    *(.data .data.*)
    *(.sdata .sdata.*)
    . = ALIGN(4);
    __data_end = .;
  } > DATA AT > IMAGE
  __data_load_start = LOADADDR(.data);
  PROVIDE(__global_pointer$ = __data_start + 0x800);

@BANK_DATA_SECTIONS@

@BANK_BSS_SECTIONS@

  .bss (NOLOAD) : ALIGN(4)
  {
    . = ALIGN(4);
    __bss_start = .;
    *(.bss .bss.*)
    *(.sbss .sbss.*)
    *(COMMON)
    . = ALIGN(4);
    __bss_end = .;
  } > DATA

  __heap_start = ALIGN(__bss_end, 16);
  __stack_top = (ORIGIN(DATA) + LENGTH(DATA)) & ~15;
  __heap_end = __stack_top;
  ASSERT(__heap_start <= __stack_top, "Default data memory overflow")

  /DISCARD/ :
  {
    *(.comment)
    *(.note .note.*)
  }
}
